## s3/firmware/sdkconfig.defaults
```kconfig
## M4-matter, target-agnostic settings that layer on top of sdkconfig.defaults.common.
## Target-specific bits (flash size, USB console) live in sdkconfig.defaults.esp32s3.

## WARN default + CHIP_DETAIL off keeps USB-CDC TX volume low. The console
## blocks per-byte ~50 ms (TX_FLUSH_TIMEOUT_US in usb_serial_jtag_vfs.c) when
## no host reader is attached; INFO chatter during PASE/AddNOC pushes the
## CHIP task into that stall and times commissioning out. LOG_MAXIMUM_LEVEL
## from common stays at DEBUG so esp_log_level_set() can raise at runtime.
CONFIG_LOG_DEFAULT_LEVEL_WARN=y
# CONFIG_LOG_DEFAULT_LEVEL_INFO is not set
CONFIG_CHIP_DETAIL_LOGGING=n
CONFIG_CHIP_PROGRESS_LOGGING=y
CONFIG_CHIP_ERROR_LOGGING=y

## Custom partition table for the 8 MB XIAO S3 — OTA slots at 2 MB each + fctry
## partition for per-device DAC (Phase 16/14d production flow).
CONFIG_PARTITION_TABLE_CUSTOM=y
CONFIG_PARTITION_TABLE_FILENAME="partitions.csv"
CONFIG_PARTITION_TABLE_OFFSET=0xC000

## Matter / NimBLE — esp-matter requires NimBLE (not Bluedroid).
CONFIG_BT_ENABLED=y
CONFIG_BT_NIMBLE_ENABLED=y
CONFIG_BT_BLUEDROID_ENABLED=n
CONFIG_BT_NIMBLE_ENABLE_CONN_REATTEMPT=n

## IPv6 for Matter operational routing. NUM_ADDRESSES=8 covers link-local +
## SLAAC ULA + one per fabric plus transients during a commission window.
CONFIG_LWIP_IPV6_AUTOCONFIG=y
CONFIG_LWIP_HOOK_IP6_ROUTE_DEFAULT=y
CONFIG_LWIP_HOOK_ND6_GET_GW_DEFAULT=y
CONFIG_LWIP_IPV6_NUM_ADDRESSES=8
CONFIG_LWIP_IPV6_MEMP_NUM_ND6_QUEUE=5
CONFIG_MBEDTLS_HKDF_C=y

## CHIP task priority 2 dispatches MRP retransmits promptly during
## commissioning while staying below LwIP (18) and WiFi (23). Stack headroom
## for a subscribe-all ReadHandler fan-out; long-dispatch threshold surfaces
## slow callbacks in the log.
CONFIG_CHIP_TASK_PRIORITY=2
CONFIG_CHIP_TASK_STACK_SIZE=10240
CONFIG_DISPATCH_EVENT_LONG_DISPATCH_TIME_WARNING_THRESHOLD_MS=200

## MRP retransmit budget fits inside the Nest hub's ~5 s exchange ceiling.
CONFIG_MRP_MAX_RETRANS=6
CONFIG_MRP_RETRY_INTERVAL_SENDER_BOOST_FOR_WIFI_ETHERNET=100

## WiFi RX buffers + BA window sized for the BLE→WiFi handover + operational
## mDNS burst. Matches the esp-matter light example.
CONFIG_ESP_WIFI_STATIC_RX_BUFFER_NUM=16
CONFIG_ESP_WIFI_DYNAMIC_RX_BUFFER_NUM=48
CONFIG_ESP_WIFI_RX_BA_WIN=16


## Release NIMBLE controller memory post-commission (~30 KB back to heap).
CONFIG_BT_NIMBLE_MEM_OPTIMIZATION=y

## BLE ATT MTU 517 + Data Length Extension — CSRResponse /
## AttestationResponse / AddNOC (400-700 B) ship in one GATT indication
## instead of fragmenting into ~6 L2CAP PDUs.
CONFIG_BT_NIMBLE_ATT_PREFERRED_MTU=517
CONFIG_BT_NIMBLE_LL_CFG_FEAT_LE_DATA_LENGTH_EXTENSION=y
CONFIG_BT_NIMBLE_ACL_BUF_COUNT=12
CONFIG_BT_NIMBLE_ACL_BUF_SIZE=255
CONFIG_BT_NIMBLE_HOST_TASK_STACK_SIZE=6144
CONFIG_BT_NIMBLE_MSYS1_BLOCK_COUNT=24

## Device-side failsafe ceiling above the worst-case software ECDSA time
## so a slow CSR never trips our own guard.
CONFIG_CHIP_DEVICE_CONFIG_FAILSAFE_EXPIRY_LENGTH_SEC=90

## Pin BT controller + NimBLE host to core 0 so coexistence stays
## single-core alongside WiFi / lwIP / CHIP.
CONFIG_BT_NIMBLE_PINNED_TO_CORE_0=y
CONFIG_BT_CTRL_PINNED_TO_CORE_0=y

## Root node + ColorTemperatureLight endpoints.
CONFIG_ESP_MATTER_MAX_DYNAMIC_ENDPOINT_COUNT=2

## Flash auto-suspend keeps cache (and the encoder ISRs) alive during NVS
## erase/write — CHIP's deferred-persistence commits otherwise freeze both
## cores mid-travel and drop quadrature counts.
CONFIG_SPI_FLASH_AUTO_SUSPEND=y

## CHIP_SHELL OFF: shell console busy-loops on usb_serial_jtag_read() with no host attached, starves IDLE, TWDT panics ~5 s. Required off for external-power boot.
# CONFIG_ENABLE_CHIP_SHELL is not set
CONFIG_ENABLE_OTA_REQUESTOR=y
CONFIG_ENABLE_WIFI_AP=n
CONFIG_ESP_WIFI_SOFTAP_SUPPORT=n

## Clean reboot if any task starves IDLE — prefer reset over freeze on regression.
CONFIG_ESP_TASK_WDT_PANIC=y

## Core 1 is dedicated to the FOC busy loop; IDLE there is expected to starve.
## Disabling the IDLE-WDT check avoids ~1 kHz "task not found" log spam that
## floods USB-CDC TX (and would tank commissioning per the CDC backpressure note).
CONFIG_ESP_TASK_WDT_CHECK_IDLE_TASK_CPU1=n

## TCPIP task headroom for the mDNS + CASE burst right after commissioning.
CONFIG_LWIP_TCPIP_TASK_STACK_SIZE=4096

## Symmetric AMPDU window — RX is already 16; bring TX up to match.
CONFIG_ESP_WIFI_TX_BA_WIN=16

## --- Signed OTA images (NO hardware Secure Boot, no eFuse burn) ---
## Every build is signed; the running app verifies the RSA-3072 signature of an
## OTA image before applying it, so a spoofed URL can't push unsigned firmware.
## Fully reversible — nothing is burned into eFuses. The signing key lives at
## ota_signing_key.pem (gitignored; it is the OTA root of trust — back it up).
CONFIG_SECURE_SIGNED_APPS_NO_SECURE_BOOT=y
CONFIG_SECURE_SIGNED_APPS_RSA_SCHEME=y
CONFIG_SECURE_SIGNED_ON_UPDATE_NO_SECURE_BOOT=y
CONFIG_SECURE_BOOT_SIGNING_KEY="ota_signing_key.pem"

## Matter SoftwareVersion mirrors the firmware/OTA version (bump per release).
CONFIG_DEVICE_SOFTWARE_VERSION_NUMBER=10004

## Skip the ~1 s ARP probe after each Wi-Fi reconnect; Matter wants the IP back fast.
## (Choice symbol: "ARP_CHECK=n" is ignored by kconfgen — the alternative member must be selected.)
CONFIG_LWIP_DHCP_DOES_NOT_CHECK_OFFERED_IP=y

## Heap poisoning OFF: ~15 % allocation overhead is a real cost during PASE (lots of small allocs); revert to LIGHT only for heap-corruption debugging.
# CONFIG_HEAP_POISONING_LIGHT is not set

## mDNS metadata slots for Matter operational discovery + commissioner advertising.
CONFIG_LWIP_NUM_NETIF_CLIENT_DATA=4

## Brownout threshold to LVL_SEL_7 (~2.44 V) so brief 3V3 sags during WiFi assoc /
## BLE peak TX bursts on external 5V (Schottky drop + thin VBUS impedance) don't
## reset the chip. Default LVL_SEL_3 (~2.98 V) trips on every external-power burst.
CONFIG_ESP_BROWNOUT_DET=y
CONFIG_ESP_BROWNOUT_DET_LVL_SEL_7=y

## mbedTLS hardware accel — shortens the PASE / CSR crypto window during which
## BLE + CPU are both peaked, reducing exposure to rail sag during commissioning.
CONFIG_MBEDTLS_HARDWARE_MPI=y
CONFIG_MBEDTLS_HARDWARE_AES=y
CONFIG_MBEDTLS_HARDWARE_SHA=y

## Cluster trim — keep only what ColorTemperatureLight uses (OnOff + LevelControl +
## ColorControl are on by default). Everything below saves flash.
CONFIG_SUPPORT_ACCOUNT_LOGIN_CLUSTER=n
CONFIG_SUPPORT_ACTIVATED_CARBON_FILTER_MONITORING_CLUSTER=n
CONFIG_SUPPORT_AIR_QUALITY_CLUSTER=n
CONFIG_SUPPORT_APPLICATION_BASIC_CLUSTER=n
CONFIG_SUPPORT_APPLICATION_LAUNCHER_CLUSTER=n
CONFIG_SUPPORT_AUDIO_OUTPUT_CLUSTER=n
CONFIG_SUPPORT_BOOLEAN_STATE_CONFIGURATION_CLUSTER=n
CONFIG_SUPPORT_BRIDGED_DEVICE_BASIC_INFORMATION_CLUSTER=n
CONFIG_SUPPORT_CAMERA_AV_SETTINGS_USER_LEVEL_MANAGEMENT_CLUSTER=n
CONFIG_SUPPORT_CARBON_DIOXIDE_CONCENTRATION_MEASUREMENT_CLUSTER=n
CONFIG_SUPPORT_CARBON_MONOXIDE_CONCENTRATION_MEASUREMENT_CLUSTER=n
CONFIG_SUPPORT_CHANNEL_CLUSTER=n
CONFIG_SUPPORT_CHIME_CLUSTER=n
CONFIG_SUPPORT_CLOSURE_CONTROL_CLUSTER=n
CONFIG_SUPPORT_CLOSURE_DIMENSION_CLUSTER=n
CONFIG_SUPPORT_COMMISSIONER_CONTROL_CLUSTER=n
CONFIG_SUPPORT_CONTENT_LAUNCHER_CLUSTER=n
CONFIG_SUPPORT_CONTENT_CONTROL_CLUSTER=n
CONFIG_SUPPORT_CONTENT_APP_OBSERVER_CLUSTER=n
CONFIG_SUPPORT_DEVICE_ENERGY_MANAGEMENT_CLUSTER=n
CONFIG_SUPPORT_DEVICE_ENERGY_MANAGEMENT_MODE_CLUSTER=n
CONFIG_SUPPORT_DIAGNOSTIC_LOGS_CLUSTER=n
CONFIG_SUPPORT_DISHWASHER_ALARM_CLUSTER=n
CONFIG_SUPPORT_DISHWASHER_MODE_CLUSTER=n
CONFIG_SUPPORT_MICROWAVE_OVEN_MODE_CLUSTER=n
CONFIG_SUPPORT_MICROWAVE_OVEN_CONTROL_CLUSTER=n
CONFIG_SUPPORT_DOOR_LOCK_CLUSTER=n
CONFIG_SUPPORT_ECOSYSTEM_INFORMATION_CLUSTER=n
CONFIG_SUPPORT_ELECTRICAL_ENERGY_MEASUREMENT_CLUSTER=n
CONFIG_SUPPORT_ELECTRICAL_POWER_MEASUREMENT_CLUSTER=n
CONFIG_SUPPORT_ENERGY_EVSE_CLUSTER=n
CONFIG_SUPPORT_ENERGY_EVSE_MODE_CLUSTER=n
CONFIG_SUPPORT_ENERGY_PREFERENCE_CLUSTER=n
CONFIG_SUPPORT_FAN_CONTROL_CLUSTER=n
CONFIG_SUPPORT_FAULT_INJECTION_CLUSTER=n
CONFIG_SUPPORT_FIXED_LABEL_CLUSTER=n
CONFIG_SUPPORT_FORMALDEHYDE_CONCENTRATION_MEASUREMENT_CLUSTER=n
CONFIG_SUPPORT_HEPA_FILTER_MONITORING_CLUSTER=n
CONFIG_SUPPORT_ICD_MANAGEMENT_CLUSTER=n
CONFIG_SUPPORT_KEYPAD_INPUT_CLUSTER=n
CONFIG_SUPPORT_LAUNDRY_WASHER_MODE_CLUSTER=n
CONFIG_SUPPORT_LOCALIZATION_CONFIGURATION_CLUSTER=n
CONFIG_SUPPORT_LOW_POWER_CLUSTER=n
CONFIG_SUPPORT_MEDIA_INPUT_CLUSTER=n
CONFIG_SUPPORT_MEDIA_PLAYBACK_CLUSTER=n
CONFIG_SUPPORT_MESSAGES_CLUSTER=n
CONFIG_SUPPORT_MODE_SELECT_CLUSTER=n
CONFIG_SUPPORT_NITROGEN_DIOXIDE_CONCENTRATION_MEASUREMENT_CLUSTER=n
CONFIG_SUPPORT_SAMPLE_MEI_CLUSTER=n
CONFIG_SUPPORT_OCCUPANCY_SENSING_CLUSTER=n
CONFIG_SUPPORT_POWER_TOPOLOGY_CLUSTER=n
CONFIG_SUPPORT_OPERATIONAL_STATE_CLUSTER=n
CONFIG_SUPPORT_OPERATIONAL_STATE_OVEN_CLUSTER=n
CONFIG_SUPPORT_OPERATIONAL_STATE_RVC_CLUSTER=n
CONFIG_SUPPORT_OVEN_MODE_CLUSTER=n
CONFIG_SUPPORT_OZONE_CONCENTRATION_MEASUREMENT_CLUSTER=n
CONFIG_SUPPORT_PM10_CONCENTRATION_MEASUREMENT_CLUSTER=n
CONFIG_SUPPORT_PM1_CONCENTRATION_MEASUREMENT_CLUSTER=n
CONFIG_SUPPORT_PM2_5_CONCENTRATION_MEASUREMENT_CLUSTER=n
CONFIG_SUPPORT_POWER_SOURCE_CLUSTER=n
CONFIG_SUPPORT_POWER_SOURCE_CONFIGURATION_CLUSTER=n
CONFIG_SUPPORT_PUMP_CONFIGURATION_AND_CONTROL_CLUSTER=n
CONFIG_SUPPORT_RADON_CONCENTRATION_MEASUREMENT_CLUSTER=n
CONFIG_SUPPORT_REFRIGERATOR_ALARM_CLUSTER=n
CONFIG_SUPPORT_REFRIGERATOR_AND_TEMPERATURE_CONTROLLED_CABINET_MODE_CLUSTER=n
CONFIG_SUPPORT_RVC_CLEAN_MODE_CLUSTER=n
CONFIG_SUPPORT_RVC_RUN_MODE_CLUSTER=n
CONFIG_SUPPORT_SERVICE_AREA_CLUSTER=n
CONFIG_SUPPORT_SMOKE_CO_ALARM_CLUSTER=n
CONFIG_SUPPORT_SOFTWARE_DIAGNOSTICS_CLUSTER=n
CONFIG_SUPPORT_SWITCH_CLUSTER=n
CONFIG_SUPPORT_TARGET_NAVIGATOR_CLUSTER=n
CONFIG_SUPPORT_TEMPERATURE_CONTROL_CLUSTER=n
CONFIG_SUPPORT_THERMOSTAT_CLUSTER=n
CONFIG_SUPPORT_THERMOSTAT_USER_INTERFACE_CONFIGURATION_CLUSTER=n
CONFIG_SUPPORT_THREAD_BORDER_ROUTER_MANAGEMENT_CLUSTER=n
CONFIG_SUPPORT_THREAD_NETWORK_DIRECTORY_CLUSTER=n
CONFIG_SUPPORT_TIME_FORMAT_LOCALIZATION_CLUSTER=n
CONFIG_SUPPORT_TIME_SYNCHRONIZATION_CLUSTER=n
CONFIG_SUPPORT_TIMER_CLUSTER=n
CONFIG_SUPPORT_TVOC_CONCENTRATION_MEASUREMENT_CLUSTER=n
CONFIG_SUPPORT_UNIT_TESTING_CLUSTER=n
CONFIG_SUPPORT_USER_LABEL_CLUSTER=n
CONFIG_SUPPORT_VALVE_CONFIGURATION_AND_CONTROL_CLUSTER=n
CONFIG_SUPPORT_WAKE_ON_LAN_CLUSTER=n
CONFIG_SUPPORT_LAUNDRY_WASHER_CONTROLS_CLUSTER=n
CONFIG_SUPPORT_LAUNDRY_DRYER_CONTROLS_CLUSTER=n
CONFIG_SUPPORT_WIFI_NETWORK_MANAGEMENT_CLUSTER=n
CONFIG_SUPPORT_WINDOW_COVERING_CLUSTER=n
CONFIG_SUPPORT_WATER_HEATER_MANAGEMENT_CLUSTER=n
CONFIG_SUPPORT_WATER_HEATER_MODE_CLUSTER=n
CONFIG_SUPPORT_ELECTRICAL_GRID_CONDITIONS_CLUSTER=n
CONFIG_SUPPORT_COMMODITY_PRICE_CLUSTER=n
CONFIG_SUPPORT_METER_IDENTIFICATION_CLUSTER=n
CONFIG_SUPPORT_UNIT_LOCALIZATION_CLUSTER=n
CONFIG_SUPPORT_COMMODITY_METERING_CLUSTER=n
CONFIG_SUPPORT_COMMODITY_TARIFF_CLUSTER=n
CONFIG_SUPPORT_PUSH_AV_STREAM_TRANSPORT_CLUSTER=n

## Pin fast BLE adv to 20 ms (32 × 0.625 ms) min/max — Apple/Google both prefer this
## window. NimBLE often lands at the upper bound under load, missing the controller's
## first scan; equal min/max forces tight scheduling.
CONFIG_BLE_FAST_ADVERTISING_INTERVAL_MIN=32
CONFIG_BLE_FAST_ADVERTISING_INTERVAL_MAX=32

## Extended commissionable discovery — keep mDNS commissionable records published
## for 48 h after the fast-adv window expires, so a controller can still find a
## half-commissioned device on retry instead of giving up at the 15 min default.
CONFIG_ENABLE_EXTENDED_DISCOVERY=y

## WiFi + BT coex on the S3's single 2.4 GHz radio: PHY-coded TX/RX time limit
## prevents long BLE bursts from starving WiFi (and vice versa) during PASE.
CONFIG_BT_CTRL_COEX_PHY_CODED_TX_RX_TLIM_EN=y
```

## s3/m1-motor/sdkconfig.defaults.esp32s3
```kconfig
CONFIG_IDF_TARGET="esp32s3"

## USB-C (USB_SERIAL_JTAG peripheral, same as C6 — not TinyUSB). Primary console is
## ESP_LOGI / printf; arduino Serial is also routed here via the
## -DARDUINO_USB_CDC_ON_BOOT=1 -DARDUINO_USB_MODE=1 defines in common/CMakeLists.txt.
CONFIG_ESP_CONSOLE_USB_SERIAL_JTAG=y
CONFIG_ESP_CONSOLE_SECONDARY_NONE=y

## 8 MB flash on XIAO S3. M1 doesn't need OTA, but flash-size must match real hw.
CONFIG_ESPTOOLPY_FLASHSIZE_8MB=y

## Quad PSRAM — not critical for motor-only, but cheap to enable and useful for
## consistency with later stages where Matter will want it.
CONFIG_SPIRAM=y
CONFIG_SPIRAM_MODE_QUAD=y
CONFIG_SPIRAM_SPEED_80M=y

## No BT, no WiFi — purely motor bring-up.
CONFIG_BT_ENABLED=n
```

## s3/m2-knob/sdkconfig.defaults.esp32s3
```kconfig
CONFIG_IDF_TARGET="esp32s3"

## USB-C console via USB_SERIAL_JTAG (printf + arduino Serial both route here).
CONFIG_ESP_CONSOLE_USB_SERIAL_JTAG=y
CONFIG_ESP_CONSOLE_SECONDARY_NONE=y

CONFIG_ESPTOOLPY_FLASHSIZE_8MB=y

## PSRAM disabled — XIAO S3 uses ESP32-S3R8 with Octal PSRAM that doesn't boot
## with QUAD. M2 has no need for extra RAM anyway (no Matter, no WiFi).
# CONFIG_SPIRAM is not set

## No BT, no WiFi — motor + knob only.
CONFIG_BT_ENABLED=n
```

## s3/m3-leds/sdkconfig.defaults.esp32s3
```kconfig
CONFIG_IDF_TARGET="esp32s3"

## USB-C console via USB_SERIAL_JTAG.
CONFIG_ESP_CONSOLE_USB_SERIAL_JTAG=y
CONFIG_ESP_CONSOLE_SECONDARY_NONE=y

CONFIG_ESPTOOLPY_FLASHSIZE_8MB=y

## PSRAM disabled — XIAO S3R8 needs Octal not Quad (same fix as M1/M2).
# CONFIG_SPIRAM is not set

## No BT, no WiFi — motor + knob + LEDs only.
CONFIG_BT_ENABLED=n
```

## s3/m4-matter/sdkconfig.defaults.esp32s3
```kconfig
CONFIG_IDF_TARGET="esp32s3"

## Run at the S3's rated 240 MHz — mbedTLS ECDSA during Matter commissioning
## (PASE_Pake2 + CSR keypair) finishes inside the commissioner's per-step
## timeout only at full clock.
CONFIG_ESP_DEFAULT_CPU_FREQ_MHZ_240=y
CONFIG_ESP_DEFAULT_CPU_FREQ_MHZ=240
CONFIG_ESP32S3_DEFAULT_CPU_FREQ_240=y
CONFIG_ESP32S3_DEFAULT_CPU_FREQ_MHZ=240

## USB-CDC console via USB_SERIAL_JTAG; Arduino Serial routes here via
## ARDUINO_USB_MODE=1 in main/CMakeLists.txt.
CONFIG_ESP_CONSOLE_USB_SERIAL_JTAG=y
CONFIG_ESP_CONSOLE_SECONDARY_NONE=y

## PSRAM off: the BT controller pins its allocs to INTERNAL|DMA caps
## (IDF bt.c:BLE_CONTROLLER_MALLOC_CAPS), so PSRAM never helps BLE bring-up,
## and enabling it destabilises commissioning on S3R8's Octal-PSRAM variant.
CONFIG_ESPTOOLPY_FLASHSIZE_8MB=y
# CONFIG_SPIRAM is not set

## Factory data providers read VID / PID / discriminator / Spake2+ verifier /
## DAC from the `fctry` + `esp_secure_cert` partitions populated by
## esp-matter-mfg-tool. A board without those partitions flashed fails
## commissioning with GetSetupDiscriminator()=CHIP_ERROR_INVALID_ARGUMENT.
CONFIG_ENABLE_ESP32_FACTORY_DATA_PROVIDER=y
CONFIG_ENABLE_ESP32_DEVICE_INSTANCE_INFO_PROVIDER=y
CONFIG_SEC_CERT_DAC_PROVIDER=y
CONFIG_FACTORY_COMMISSIONABLE_DATA_PROVIDER=y

## Matter factory data lives in the `fctry` partition, not CHIP's default
## `nvs` where it stores fabric state.
CONFIG_CHIP_FACTORY_NAMESPACE_PARTITION_LABEL="fctry"

## Both SECURE_CERT flags off so CHIP's DAC provider sees
## esp_secure_cert_get_priv_key (gated by #ifndef DS_PERIPHERAL) AND
## esp_secure_cert_get_priv_key_type (gated by #ifndef LEGACY_FORMATS).
## Plain-blob DAC from our mfg_tool invocation needs both visible.
# CONFIG_ESP_SECURE_CERT_DS_PERIPHERAL is not set
# CONFIG_ESP_SECURE_CERT_SUPPORT_LEGACY_FORMATS is not set

## TWDT panic on timeout: if any task starves the IDLE task on core 0 >5 s,
## reset cleanly (reason 0x06) instead of just logging. Production safety —
## any future busy-loop bug self-recovers via reboot rather than bricking.
CONFIG_ESP_TASK_WDT_PANIC=y

## Auto-open the commissioning window at boot when not yet commissioned —
## starts BLE advertising so Apple Home / Google Home can discover the
## device. Kconfig default is y but we explicitly assert it here so a stray
## "is not set" override (e.g. from a stale sdkconfig) can't disable
## commissioning silently.
CONFIG_CHIP_ENABLE_PAIRING_AUTOSTART=y
```
